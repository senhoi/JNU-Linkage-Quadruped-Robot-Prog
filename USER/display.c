#include "display.h"

int InterfaceIndex = ROBOT_INTERFACE_MODE;

void ShowInfo(void)
{
	static ActrParaTypedef *pActrParaDev = NULL;
	char sActrState[12];
	char prev_sActrState[12];
	char sFootGrounding[4][4] = {{"LM1"}, {"LM2"}, {"RM2"}, {"RM1"}};
	char prev_sAutoTime[12];
	char sAutoTime[12];
	char prev_sStepState[12];
	char sStepState[12];

	static int shadow_ActivateFlag = -1;
	static int shadow_AutoManualFlag = -1;
	static int shadow_InterfaceIndex = -1;
	static uint8_t shadow_FootGrounding = 0xff;

	extern int ActivateFlag;
	extern int AutoManualFlag;

	extern int AutoTime_S;
	extern int AutoTime_MS;
	extern uint8_t FootGrounding;

	extern uint8_t StepIndex;
	extern uint8_t StepIndex_Pause;
	extern uint8_t StepIndex_PauseFlag;

	for (int i = 0; i < ACTR_DEV_NUM; i++)
	{
		pActrParaDev = FindActrDevByID(devIDList[i]);
		if (pActrParaDev->actrWarnState.ActrWarnStateAll != 0)
		{
			POINT_COLOR = RED;
			sprintf(sActrState, "ACTR-ERR");
			break;
		}
		else if (pActrParaDev->actrWarnState.ActrWarnStateAll == 0)
		{
			POINT_COLOR = GREEN;
			sprintf(sActrState, "ACTR-OK ");
		}
	}
	LCD_FastShowString(INFO_DISP_SET_COL(INFO_DISP_COL_TAB), INFO_DISP_SET_ROW(1), INFO_DISP_STA_LABELWIDTH, INFO_DISP_STA_LABELHEIGHT, INFO_DISP_FONTSIZE, LCD_MODE_NOT_OVERLAY, (u8 *)prev_sActrState, (u8 *)sActrState);

	if (shadow_FootGrounding != FootGrounding || shadow_InterfaceIndex != InterfaceIndex)
	{
		for (int i = 0; i < 4; i++)
		{
			if ((FootGrounding & (0x01 << i)))
			{
				POINT_COLOR = RED;
			}
			else
			{
				POINT_COLOR = GREEN;
			}
			LCD_ShowString(INFO_DISP_SET_COL(INFO_DISP_COL_TAB) + INFO_DISP_SET_COL(INFO_DISP_COL_TAB) * 2 * i, INFO_DISP_SET_ROW(2), INFO_DISP_STA_LABELWIDTH, INFO_DISP_STA_LABELHEIGHT, INFO_DISP_FONTSIZE, LCD_MODE_NOT_OVERLAY, (u8 *)sFootGrounding[i]);
		}
	}

	if (shadow_ActivateFlag != ActivateFlag || shadow_InterfaceIndex != InterfaceIndex)
	{
		if (ActivateFlag == STOP)
		{
			POINT_COLOR = RED;
			LCD_ShowString(INFO_DISP_SET_COL(20), INFO_DISP_SET_ROW(1), INFO_DISP_STA_LABELWIDTH, INFO_DISP_STA_LABELHEIGHT, INFO_DISP_FONTSIZE, LCD_MODE_NOT_OVERLAY, "STOP");
		}
		else if (ActivateFlag == RUN)
		{
			POINT_COLOR = GREEN;
			LCD_ShowString(INFO_DISP_SET_COL(20), INFO_DISP_SET_ROW(1), INFO_DISP_STA_LABELWIDTH, INFO_DISP_STA_LABELHEIGHT, INFO_DISP_FONTSIZE, LCD_MODE_NOT_OVERLAY, "RUN ");
		}
		else if (ActivateFlag == ERROR)
		{
			POINT_COLOR = RED;
			LCD_ShowString(INFO_DISP_SET_COL(20), INFO_DISP_SET_ROW(1), INFO_DISP_STA_LABELWIDTH, INFO_DISP_STA_LABELHEIGHT, INFO_DISP_FONTSIZE, LCD_MODE_NOT_OVERLAY, "ERR-");
		}
	}

	if (shadow_AutoManualFlag != AutoManualFlag || shadow_InterfaceIndex != InterfaceIndex)
	{
		if (AutoManualFlag == AUTO_L)
		{
			POINT_COLOR = LBBLUE;
			LCD_ShowString(INFO_DISP_SET_COL(20), INFO_DISP_SET_ROW(2), INFO_DISP_STA_LABELWIDTH, INFO_DISP_STA_LABELHEIGHT, INFO_DISP_FONTSIZE, LCD_MODE_NOT_OVERLAY, "AUTO_L");
		}
		else if (AutoManualFlag == AUTO_R)
		{
			POINT_COLOR = BRRED;
			LCD_ShowString(INFO_DISP_SET_COL(20), INFO_DISP_SET_ROW(2), INFO_DISP_STA_LABELWIDTH, INFO_DISP_STA_LABELHEIGHT, INFO_DISP_FONTSIZE, LCD_MODE_NOT_OVERLAY, "AUTO_R");
		}
		else if (AutoManualFlag == MANUAL)
		{
			POINT_COLOR = GREEN;
			LCD_ShowString(INFO_DISP_SET_COL(20), INFO_DISP_SET_ROW(2), INFO_DISP_STA_LABELWIDTH, INFO_DISP_STA_LABELHEIGHT, INFO_DISP_FONTSIZE, LCD_MODE_NOT_OVERLAY, "MANUAL");
		}
		else
		{
			POINT_COLOR = BLACK;
			LCD_ShowString(INFO_DISP_SET_COL(20), INFO_DISP_SET_ROW(2), INFO_DISP_STA_LABELWIDTH, INFO_DISP_STA_LABELHEIGHT, INFO_DISP_FONTSIZE, LCD_MODE_NOT_OVERLAY, "IDLE  ");
		}
	}

	POINT_COLOR = BLUE;
	sprintf(sAutoTime, "T:%7.3f", AutoTime_S + AutoTime_MS / 1000.0f);
	LCD_FastShowString(INFO_DISP_SET_COL(INFO_DISP_COL_TAB), INFO_DISP_SET_ROW(3), INFO_DISP_STA_LABELWIDTH, INFO_DISP_STA_LABELHEIGHT, INFO_DISP_FONTSIZE, LCD_MODE_NOT_OVERLAY, (u8 *)prev_sAutoTime, (u8 *)sAutoTime);

	if (StepIndex_PauseFlag == STEP_PAUSED && StepIndex_Pause == StepIndex)
		sprintf(sStepState, "S:%d PAUSED", StepIndex);
	else if (StepIndex_PauseFlag == STEP_CONTINUE || StepIndex_Pause != StepIndex)
		sprintf(sStepState, "S:%d %5.2f", StepIndex, actrRefPhase / 4.0f + actrRefRevolution);
	else if (StepIndex == 128)
		sprintf(sStepState, "S:%d DONE  ", StepIndex);

	LCD_FastShowString(INFO_DISP_SET_COL(20), INFO_DISP_SET_ROW(3), INFO_DISP_STA_LABELWIDTH, INFO_DISP_STA_LABELHEIGHT, INFO_DISP_FONTSIZE, LCD_MODE_NOT_OVERLAY, (u8 *)prev_sStepState, (u8 *)sStepState);

	shadow_ActivateFlag = ActivateFlag;
	shadow_AutoManualFlag = AutoManualFlag;
	shadow_InterfaceIndex = InterfaceIndex;
	shadow_FootGrounding = FootGrounding;
}

int ModeCursorIndex = 1;

void MoveModeCursor(void)
{
	if (ModeCursorIndex == INTERFACE_NUM + 1)
		ModeCursorIndex = 1;

	if (ModeCursorIndex - 1 == 0)
	{
		LCD_Fill(ACTR_DISP_SET_COL(ACRT_DISP_COL_TAB), ACTR_DISP_SET_ROW(INTERFACE_NUM), ACTR_DISP_SET_COL(ACRT_DISP_COL_TAB) + ACTR_DISP_STA_LABELWIDTH, ACTR_DISP_SET_ROW(INTERFACE_NUM) + ACTR_DISP_STA_LABELHEIGHT, WHITE);
		POINT_COLOR = BLACK;
		ShowModeSelection(INTERFACE_NUM);
	}
	else
	{
		LCD_Fill(ACTR_DISP_SET_COL(ACRT_DISP_COL_TAB), ACTR_DISP_SET_ROW(ModeCursorIndex - 1), ACTR_DISP_SET_COL(ACRT_DISP_COL_TAB) + ACTR_DISP_STA_LABELWIDTH, ACTR_DISP_SET_ROW(ModeCursorIndex - 1) + ACTR_DISP_STA_LABELHEIGHT, WHITE);
		POINT_COLOR = BLACK;
		ShowModeSelection(ModeCursorIndex - 1);
	}

	LCD_Fill(ACTR_DISP_SET_COL(ACRT_DISP_COL_TAB), ACTR_DISP_SET_ROW(ModeCursorIndex), ACTR_DISP_SET_COL(ACRT_DISP_COL_TAB) + ACTR_DISP_STA_LABELWIDTH, ACTR_DISP_SET_ROW(ModeCursorIndex) + ACTR_DISP_STA_LABELHEIGHT, DARKBLUE);
	POINT_COLOR = WHITE;
	ShowModeSelection(ModeCursorIndex);
}

void ShowModeSelection(int index)
{
	switch (index)
	{
	case -1:
		LCD_Clear(WHITE);
		POINT_COLOR = BLACK;
		LCD_ShowString(ACTR_DISP_SET_COL(ACRT_DISP_COL_TAB), ACTR_DISP_SET_ROW(-1), ACTR_DISP_STA_LABELWIDTH, ACTR_DISP_STA_LABELHEIGHT, ACTR_DISP_FONTSIZE, LCD_MODE_OVERLAY, "MODE-SEL:");
		LCD_ShowString(ACTR_DISP_SET_COL(ACRT_DISP_COL_TAB), ACTR_DISP_SET_ROW(1), ACTR_DISP_STA_LABELWIDTH, ACTR_DISP_STA_LABELHEIGHT, ACTR_DISP_FONTSIZE, LCD_MODE_OVERLAY, "ACTR ON");
		LCD_ShowString(ACTR_DISP_SET_COL(ACRT_DISP_COL_TAB), ACTR_DISP_SET_ROW(2), ACTR_DISP_STA_LABELWIDTH, ACTR_DISP_STA_LABELHEIGHT, ACTR_DISP_FONTSIZE, LCD_MODE_OVERLAY, "SET H-MODE");
		LCD_ShowString(ACTR_DISP_SET_COL(ACRT_DISP_COL_TAB), ACTR_DISP_SET_ROW(3), ACTR_DISP_STA_LABELWIDTH, ACTR_DISP_STA_LABELHEIGHT, ACTR_DISP_FONTSIZE, LCD_MODE_OVERLAY, "SET P-MODE");
		LCD_ShowString(ACTR_DISP_SET_COL(ACRT_DISP_COL_TAB), ACTR_DISP_SET_ROW(4), ACTR_DISP_STA_LABELWIDTH, ACTR_DISP_STA_LABELHEIGHT, ACTR_DISP_FONTSIZE, LCD_MODE_OVERLAY, "WATCH PARA");
		LCD_ShowString(ACTR_DISP_SET_COL(ACRT_DISP_COL_TAB), ACTR_DISP_SET_ROW(5), ACTR_DISP_STA_LABELWIDTH, ACTR_DISP_STA_LABELHEIGHT, ACTR_DISP_FONTSIZE, LCD_MODE_OVERLAY, "ACTR OFF");
		LCD_ShowString(ACTR_DISP_SET_COL(ACRT_DISP_COL_TAB), ACTR_DISP_SET_ROW(6), ACTR_DISP_STA_LABELWIDTH, ACTR_DISP_STA_LABELHEIGHT, ACTR_DISP_FONTSIZE, LCD_MODE_OVERLAY, "DEV INFO");
		MoveModeCursor();
		break;
	case 1:
		LCD_ShowString(ACTR_DISP_SET_COL(ACRT_DISP_COL_TAB), ACTR_DISP_SET_ROW(1), ACTR_DISP_STA_LABELWIDTH, ACTR_DISP_STA_LABELHEIGHT, ACTR_DISP_FONTSIZE, LCD_MODE_OVERLAY, "ACTR ON");
		break;
	case 2:
		LCD_ShowString(ACTR_DISP_SET_COL(ACRT_DISP_COL_TAB), ACTR_DISP_SET_ROW(2), ACTR_DISP_STA_LABELWIDTH, ACTR_DISP_STA_LABELHEIGHT, ACTR_DISP_FONTSIZE, LCD_MODE_OVERLAY, "SET H-MODE");
		break;
	case 3:
		LCD_ShowString(ACTR_DISP_SET_COL(ACRT_DISP_COL_TAB), ACTR_DISP_SET_ROW(3), ACTR_DISP_STA_LABELWIDTH, ACTR_DISP_STA_LABELHEIGHT, ACTR_DISP_FONTSIZE, LCD_MODE_OVERLAY, "SET P-MODE");
		break;
	case 4:
		LCD_ShowString(ACTR_DISP_SET_COL(ACRT_DISP_COL_TAB), ACTR_DISP_SET_ROW(4), ACTR_DISP_STA_LABELWIDTH, ACTR_DISP_STA_LABELHEIGHT, ACTR_DISP_FONTSIZE, LCD_MODE_OVERLAY, "WATCH PARA");
		break;
	case 5:
		LCD_ShowString(ACTR_DISP_SET_COL(ACRT_DISP_COL_TAB), ACTR_DISP_SET_ROW(5), ACTR_DISP_STA_LABELWIDTH, ACTR_DISP_STA_LABELHEIGHT, ACTR_DISP_FONTSIZE, LCD_MODE_OVERLAY, "ACTR OFF");
		break;
	case 6:
		LCD_ShowString(ACTR_DISP_SET_COL(ACRT_DISP_COL_TAB), ACTR_DISP_SET_ROW(6), ACTR_DISP_STA_LABELWIDTH, ACTR_DISP_STA_LABELHEIGHT, ACTR_DISP_FONTSIZE, LCD_MODE_OVERLAY, "DEV INFO");
		break;
	}
}

int ActrPwrCursorIndex = 0;

void MoveActrPwrCursor(void)
{
}

void ShowActrPwrStateTitle(void)
{
	LCD_Clear(WHITE);
	POINT_COLOR = BLACK;
	LCD_ShowString(ACTR_DISP_SET_COL(ACRT_DISP_COL_TAB), ACTR_DISP_SET_ROW(-1), ACTR_DISP_STA_LABELWIDTH, ACTR_DISP_STA_LABELHEIGHT, ACTR_DISP_FONTSIZE, LCD_MODE_OVERLAY, "PWR-STATE:");
	LCD_ShowString(ACTR_DISP_SET_COL(ACRT_DISP_COL_TAB), ACTR_DISP_SET_ROW(1), ACTR_DISP_STA_LABELWIDTH, ACTR_DISP_STA_LABELHEIGHT, ACTR_DISP_FONTSIZE, LCD_MODE_OVERLAY, "LM1:");
	LCD_ShowString(ACTR_DISP_SET_COL(ACRT_DISP_COL_TAB), ACTR_DISP_SET_ROW(2), ACTR_DISP_STA_LABELWIDTH, ACTR_DISP_STA_LABELHEIGHT, ACTR_DISP_FONTSIZE, LCD_MODE_OVERLAY, "LM2:");
	LCD_ShowString(ACTR_DISP_SET_COL(ACRT_DISP_COL_TAB), ACTR_DISP_SET_ROW(3), ACTR_DISP_STA_LABELWIDTH, ACTR_DISP_STA_LABELHEIGHT, ACTR_DISP_FONTSIZE, LCD_MODE_OVERLAY, "TM:");
	LCD_ShowString(ACTR_DISP_SET_COL(ACRT_DISP_COL_TAB), ACTR_DISP_SET_ROW(4), ACTR_DISP_STA_LABELWIDTH, ACTR_DISP_STA_LABELHEIGHT, ACTR_DISP_FONTSIZE, LCD_MODE_OVERLAY, "RM2:");
	LCD_ShowString(ACTR_DISP_SET_COL(ACRT_DISP_COL_TAB), ACTR_DISP_SET_ROW(5), ACTR_DISP_STA_LABELWIDTH, ACTR_DISP_STA_LABELHEIGHT, ACTR_DISP_FONTSIZE, LCD_MODE_OVERLAY, "RM1:");
}

void ShowActrPwrState(void)
{
	static ActrParaTypedef *pActrParaDev = NULL;
	char str[14];

	for (int i = 0; i < ACTR_DEV_NUM; i++)
	{
		GetActrPara(ACTR_CMD_GET_ON_OFF, devIDList[i]);
		pActrParaDev = FindActrDevByID(devIDList[i]);

		if (pActrParaDev->actrPwrState == PWR_ON)
		{
			sprintf(str, "ID%3d Online", devIDList[i]);
		}
		else
		{
			sprintf(str, "ID%3d Offline", devIDList[i]);
		}

		switch (i)
		{
		case 0:
			LCD_ShowString(ACTR_DISP_SET_COL(ACRT_DISP_COL_TAB + ACTR_DISP_STA_LABELLEN), ACTR_DISP_SET_ROW(1), ACTR_DISP_DYN_STRINGWIDTH_L, ACTR_DISP_DYN_STRINGHEIGHT, ACTR_DISP_FONTSIZE, LCD_MODE_OVERLAY, (u8 *)str);
			break;
		case 1:
			LCD_ShowString(ACTR_DISP_SET_COL(ACRT_DISP_COL_TAB + ACTR_DISP_STA_LABELLEN), ACTR_DISP_SET_ROW(2), ACTR_DISP_DYN_STRINGWIDTH_L, ACTR_DISP_DYN_STRINGHEIGHT, ACTR_DISP_FONTSIZE, LCD_MODE_OVERLAY, (u8 *)str);
			break;
		case 2:
			LCD_ShowString(ACTR_DISP_SET_COL(ACRT_DISP_COL_TAB + ACTR_DISP_STA_LABELLEN), ACTR_DISP_SET_ROW(3), ACTR_DISP_DYN_STRINGWIDTH_L, ACTR_DISP_DYN_STRINGHEIGHT, ACTR_DISP_FONTSIZE, LCD_MODE_OVERLAY, (u8 *)str);
			break;
		case 3:
			LCD_ShowString(ACTR_DISP_SET_COL(ACRT_DISP_COL_TAB + ACTR_DISP_STA_LABELLEN), ACTR_DISP_SET_ROW(4), ACTR_DISP_DYN_STRINGWIDTH_L, ACTR_DISP_DYN_STRINGHEIGHT, ACTR_DISP_FONTSIZE, LCD_MODE_OVERLAY, (u8 *)str);
			break;
		case 4:
			LCD_ShowString(ACTR_DISP_SET_COL(ACRT_DISP_COL_TAB + ACTR_DISP_STA_LABELLEN), ACTR_DISP_SET_ROW(5), ACTR_DISP_DYN_STRINGWIDTH_L, ACTR_DISP_DYN_STRINGHEIGHT, ACTR_DISP_FONTSIZE, LCD_MODE_OVERLAY, (u8 *)str);
			break;
		}
	}
}

int ActrPosCursorIndex = 0;

void MoveActrPosCursor(void)
{
}

void ShowActrPosValTitle(void)
{
	LCD_Clear(WHITE);
	POINT_COLOR = BLACK;
	LCD_ShowString(ACTR_DISP_SET_COL(ACRT_DISP_COL_TAB), ACTR_DISP_SET_ROW(-1), ACTR_DISP_STA_LABELWIDTH, ACTR_DISP_STA_LABELHEIGHT, ACTR_DISP_FONTSIZE, LCD_MODE_OVERLAY, "ACTR-POS:");
	LCD_ShowString(ACTR_DISP_SET_COL(ACRT_DISP_COL_TAB), ACTR_DISP_SET_ROW(1), ACTR_DISP_STA_LABELWIDTH, ACTR_DISP_STA_LABELHEIGHT, ACTR_DISP_FONTSIZE, LCD_MODE_OVERLAY, "LM1:");
	LCD_ShowString(ACTR_DISP_SET_COL(ACRT_DISP_COL_TAB), ACTR_DISP_SET_ROW(2), ACTR_DISP_STA_LABELWIDTH, ACTR_DISP_STA_LABELHEIGHT, ACTR_DISP_FONTSIZE, LCD_MODE_OVERLAY, "LM2:");
	LCD_ShowString(ACTR_DISP_SET_COL(ACRT_DISP_COL_TAB), ACTR_DISP_SET_ROW(3), ACTR_DISP_STA_LABELWIDTH, ACTR_DISP_STA_LABELHEIGHT, ACTR_DISP_FONTSIZE, LCD_MODE_OVERLAY, "TM:");
	LCD_ShowString(ACTR_DISP_SET_COL(ACRT_DISP_COL_TAB), ACTR_DISP_SET_ROW(4), ACTR_DISP_STA_LABELWIDTH, ACTR_DISP_STA_LABELHEIGHT, ACTR_DISP_FONTSIZE, LCD_MODE_OVERLAY, "RM2:");
	LCD_ShowString(ACTR_DISP_SET_COL(ACRT_DISP_COL_TAB), ACTR_DISP_SET_ROW(5), ACTR_DISP_STA_LABELWIDTH, ACTR_DISP_STA_LABELHEIGHT, ACTR_DISP_FONTSIZE, LCD_MODE_OVERLAY, "RM1:");

	LCD_ShowString(ACTR_DISP_SET_COL(ACRT_DISP_COL_TAB), ACTR_DISP_SET_ROW(7), ACTR_DISP_STA_LABELWIDTH, ACTR_DISP_STA_LABELHEIGHT, ACTR_DISP_FONTSIZE, LCD_MODE_OVERLAY, "ACTR-PHASE:");
	LCD_ShowString(ACTR_DISP_SET_COL(ACRT_DISP_COL_TAB), ACTR_DISP_SET_ROW(9), ACTR_DISP_STA_LABELWIDTH, ACTR_DISP_STA_LABELHEIGHT, ACTR_DISP_FONTSIZE, LCD_MODE_OVERLAY, "LM1:");
	LCD_ShowString(ACTR_DISP_SET_COL(ACRT_DISP_COL_TAB), ACTR_DISP_SET_ROW(10), ACTR_DISP_STA_LABELWIDTH, ACTR_DISP_STA_LABELHEIGHT, ACTR_DISP_FONTSIZE, LCD_MODE_OVERLAY, "LM2:");
	LCD_ShowString(ACTR_DISP_SET_COL(ACRT_DISP_COL_TAB), ACTR_DISP_SET_ROW(11), ACTR_DISP_STA_LABELWIDTH, ACTR_DISP_STA_LABELHEIGHT, ACTR_DISP_FONTSIZE, LCD_MODE_OVERLAY, "TM:");
	LCD_ShowString(ACTR_DISP_SET_COL(ACRT_DISP_COL_TAB), ACTR_DISP_SET_ROW(12), ACTR_DISP_STA_LABELWIDTH, ACTR_DISP_STA_LABELHEIGHT, ACTR_DISP_FONTSIZE, LCD_MODE_OVERLAY, "RM2:");
	LCD_ShowString(ACTR_DISP_SET_COL(ACRT_DISP_COL_TAB), ACTR_DISP_SET_ROW(13), ACTR_DISP_STA_LABELWIDTH, ACTR_DISP_STA_LABELHEIGHT, ACTR_DISP_FONTSIZE, LCD_MODE_OVERLAY, "RM1:");
	LCD_ShowString(ACTR_DISP_SET_COL(ACRT_DISP_COL_TAB), ACTR_DISP_SET_ROW(14), ACTR_DISP_STA_LABELWIDTH, ACTR_DISP_STA_LABELHEIGHT, ACTR_DISP_FONTSIZE, LCD_MODE_OVERLAY, "REF:");
}

void ShowActrPosVal(void)
{
	static ActrParaTypedef *pActrParaDev = NULL;

	extern float actrSpd[ACTR_DEV_NUM];
	extern float actrPhase[ACTR_DEV_NUM];

	static char prev_sActrPos[ACTR_DEV_NUM][18];
	char sActrPos[ACTR_DEV_NUM][18];

	static char prev_sActrPhase[ACTR_DEV_NUM][18];
	char sActrPhase[ACTR_DEV_NUM][18];

	static char prev_sActrRefPhase[18];
	char sActrRefPhase[18];

	for (int i = 0; i < ACTR_DEV_NUM; i++)
	{
		GetActrPara(ACTR_CMD_GET_POSTION, devIDList[i]);
		pActrParaDev = FindActrDevByID(devIDList[i]);

		sprintf(sActrPos[i], "%7.2fR %7.2fR", pActrParaDev->actrPostion, actrSpd[i]);
		sprintf(sActrPhase[i], "%6.4f C:%3d", actrPhase[i], actrRevolution[i]);

		POINT_COLOR = BLACK;
		switch (i)
		{
		case 0:
			LCD_FastShowString(ACTR_DISP_SET_COL(ACRT_DISP_COL_TAB + ACTR_DISP_STA_LABELLEN), ACTR_DISP_SET_ROW(1), ACTR_DISP_DYN_STRINGWIDTH_L, ACTR_DISP_DYN_STRINGHEIGHT, ACTR_DISP_FONTSIZE, LCD_MODE_NOT_OVERLAY, (u8 *)prev_sActrPos[i], (u8 *)sActrPos[i]);
			LCD_FastShowString(ACTR_DISP_SET_COL(ACRT_DISP_COL_TAB + ACTR_DISP_STA_LABELLEN), ACTR_DISP_SET_ROW(9), ACTR_DISP_DYN_STRINGWIDTH_L, ACTR_DISP_DYN_STRINGHEIGHT, ACTR_DISP_FONTSIZE, LCD_MODE_NOT_OVERLAY, (u8 *)prev_sActrPhase[i], (u8 *)sActrPhase[i]);
			break;
		case 1:
			LCD_FastShowString(ACTR_DISP_SET_COL(ACRT_DISP_COL_TAB + ACTR_DISP_STA_LABELLEN), ACTR_DISP_SET_ROW(2), ACTR_DISP_DYN_STRINGWIDTH_L, ACTR_DISP_DYN_STRINGHEIGHT, ACTR_DISP_FONTSIZE, LCD_MODE_NOT_OVERLAY, (u8 *)prev_sActrPos[i], (u8 *)sActrPos[i]);
			LCD_FastShowString(ACTR_DISP_SET_COL(ACRT_DISP_COL_TAB + ACTR_DISP_STA_LABELLEN), ACTR_DISP_SET_ROW(10), ACTR_DISP_DYN_STRINGWIDTH_L, ACTR_DISP_DYN_STRINGHEIGHT, ACTR_DISP_FONTSIZE, LCD_MODE_NOT_OVERLAY, (u8 *)prev_sActrPhase[i], (u8 *)sActrPhase[i]);
			break;
		case 2:
			LCD_FastShowString(ACTR_DISP_SET_COL(ACRT_DISP_COL_TAB + ACTR_DISP_STA_LABELLEN), ACTR_DISP_SET_ROW(3), ACTR_DISP_DYN_STRINGWIDTH_L, ACTR_DISP_DYN_STRINGHEIGHT, ACTR_DISP_FONTSIZE, LCD_MODE_NOT_OVERLAY, (u8 *)prev_sActrPos[i], (u8 *)sActrPos[i]);
			LCD_FastShowString(ACTR_DISP_SET_COL(ACRT_DISP_COL_TAB + ACTR_DISP_STA_LABELLEN), ACTR_DISP_SET_ROW(11), ACTR_DISP_DYN_STRINGWIDTH_L, ACTR_DISP_DYN_STRINGHEIGHT, ACTR_DISP_FONTSIZE, LCD_MODE_NOT_OVERLAY, (u8 *)prev_sActrPhase[i], (u8 *)sActrPhase[i]);
			break;
		case 3:
			LCD_FastShowString(ACTR_DISP_SET_COL(ACRT_DISP_COL_TAB + ACTR_DISP_STA_LABELLEN), ACTR_DISP_SET_ROW(4), ACTR_DISP_DYN_STRINGWIDTH_L, ACTR_DISP_DYN_STRINGHEIGHT, ACTR_DISP_FONTSIZE, LCD_MODE_NOT_OVERLAY, (u8 *)prev_sActrPos[i], (u8 *)sActrPos[i]);
			LCD_FastShowString(ACTR_DISP_SET_COL(ACRT_DISP_COL_TAB + ACTR_DISP_STA_LABELLEN), ACTR_DISP_SET_ROW(12), ACTR_DISP_DYN_STRINGWIDTH_L, ACTR_DISP_DYN_STRINGHEIGHT, ACTR_DISP_FONTSIZE, LCD_MODE_NOT_OVERLAY, (u8 *)prev_sActrPhase[i], (u8 *)sActrPhase[i]);
			break;
		case 4:
			LCD_FastShowString(ACTR_DISP_SET_COL(ACRT_DISP_COL_TAB + ACTR_DISP_STA_LABELLEN), ACTR_DISP_SET_ROW(5), ACTR_DISP_DYN_STRINGWIDTH_L, ACTR_DISP_DYN_STRINGHEIGHT, ACTR_DISP_FONTSIZE, LCD_MODE_NOT_OVERLAY, (u8 *)prev_sActrPos[i], (u8 *)sActrPos[i]);
			LCD_FastShowString(ACTR_DISP_SET_COL(ACRT_DISP_COL_TAB + ACTR_DISP_STA_LABELLEN), ACTR_DISP_SET_ROW(13), ACTR_DISP_DYN_STRINGWIDTH_L, ACTR_DISP_DYN_STRINGHEIGHT, ACTR_DISP_FONTSIZE, LCD_MODE_NOT_OVERLAY, (u8 *)prev_sActrPhase[i], (u8 *)sActrPhase[i]);
			break;
		}
	}

	sprintf(sActrRefPhase, "%6.4f C:%3d", actrRefPhase, actrRefRevolution);
	LCD_FastShowString(ACTR_DISP_SET_COL(ACRT_DISP_COL_TAB + ACTR_DISP_STA_LABELLEN), ACTR_DISP_SET_ROW(14), ACTR_DISP_DYN_STRINGWIDTH_L, ACTR_DISP_DYN_STRINGHEIGHT, ACTR_DISP_FONTSIZE, LCD_MODE_NOT_OVERLAY, (u8 *)prev_sActrRefPhase, (u8 *)sActrRefPhase);
}
void ShowActrHomingPosVal(void)
{
	static ActrParaTypedef *pActrParaDev = NULL;
	char str[18];

	for (int i = 0; i < ACTR_DEV_NUM; i++)
	{
		GetActrPara(ACTR_CMD_GET_POSTION, devIDList[i]);
		pActrParaDev = FindActrDevByID(devIDList[i]);

		sprintf(str, "%6.2fR", pActrParaDev->actrPostion);

		POINT_COLOR = BLACK;
		switch (i)
		{
		case 0:
			LCD_ShowString(ACTR_DISP_SET_COL(ACRT_DISP_COL_TAB + ACTR_DISP_STA_LABELLEN), ACTR_DISP_SET_ROW(1), ACTR_DISP_DYN_STRINGWIDTH_L, ACTR_DISP_DYN_STRINGHEIGHT, ACTR_DISP_FONTSIZE, LCD_MODE_NOT_OVERLAY, (u8 *)str);
			break;
		case 1:
			LCD_ShowString(ACTR_DISP_SET_COL(ACRT_DISP_COL_TAB + ACTR_DISP_STA_LABELLEN), ACTR_DISP_SET_ROW(2), ACTR_DISP_DYN_STRINGWIDTH_L, ACTR_DISP_DYN_STRINGHEIGHT, ACTR_DISP_FONTSIZE, LCD_MODE_NOT_OVERLAY, (u8 *)str);
			break;
		case 2:
			LCD_ShowString(ACTR_DISP_SET_COL(ACRT_DISP_COL_TAB + ACTR_DISP_STA_LABELLEN), ACTR_DISP_SET_ROW(3), ACTR_DISP_DYN_STRINGWIDTH_L, ACTR_DISP_DYN_STRINGHEIGHT, ACTR_DISP_FONTSIZE, LCD_MODE_NOT_OVERLAY, (u8 *)str);
			break;
		case 3:
			LCD_ShowString(ACTR_DISP_SET_COL(ACRT_DISP_COL_TAB + ACTR_DISP_STA_LABELLEN), ACTR_DISP_SET_ROW(4), ACTR_DISP_DYN_STRINGWIDTH_L, ACTR_DISP_DYN_STRINGHEIGHT, ACTR_DISP_FONTSIZE, LCD_MODE_NOT_OVERLAY, (u8 *)str);
			break;
		case 4:
			LCD_ShowString(ACTR_DISP_SET_COL(ACRT_DISP_COL_TAB + ACTR_DISP_STA_LABELLEN), ACTR_DISP_SET_ROW(5), ACTR_DISP_DYN_STRINGWIDTH_L, ACTR_DISP_DYN_STRINGHEIGHT, ACTR_DISP_FONTSIZE, LCD_MODE_NOT_OVERLAY, (u8 *)str);
			break;
		}
	}
}

int ActrHomingCursorIndex = 1;

void MoveActrHomingCursor(void)
{
	if (ActrHomingCursorIndex == ACTR_DEV_NUM + 1)
		ActrHomingCursorIndex = 1;

	if (ActrHomingCursorIndex - 1 == 0)
	{
		LCD_Fill(ACTR_DISP_SET_COL(ACRT_DISP_COL_TAB), ACTR_DISP_SET_ROW(ACTR_DEV_NUM), ACTR_DISP_SET_COL(ACRT_DISP_COL_TAB) + ACTR_DISP_STA_LABELWIDTH, ACTR_DISP_SET_ROW(ACTR_DEV_NUM) + ACTR_DISP_STA_LABELHEIGHT, WHITE);
		POINT_COLOR = BLACK;
		ShowActrHomingTitle(ACTR_DEV_NUM);
	}
	else
	{
		LCD_Fill(ACTR_DISP_SET_COL(ACRT_DISP_COL_TAB), ACTR_DISP_SET_ROW(ActrHomingCursorIndex - 1), ACTR_DISP_SET_COL(ACRT_DISP_COL_TAB) + ACTR_DISP_STA_LABELWIDTH, ACTR_DISP_SET_ROW(ActrHomingCursorIndex - 1) + ACTR_DISP_STA_LABELHEIGHT, WHITE);
		POINT_COLOR = BLACK;
		ShowActrHomingTitle(ActrHomingCursorIndex - 1);
	}

	LCD_Fill(ACTR_DISP_SET_COL(ACRT_DISP_COL_TAB), ACTR_DISP_SET_ROW(ActrHomingCursorIndex), ACTR_DISP_SET_COL(ACRT_DISP_COL_TAB) + ACTR_DISP_STA_LABELWIDTH, ACTR_DISP_SET_ROW(ActrHomingCursorIndex) + ACTR_DISP_STA_LABELHEIGHT, DARKBLUE);
	POINT_COLOR = WHITE;
	ShowActrHomingTitle(ActrHomingCursorIndex);
}

void ShowActrHomingTitle(int index)
{
	switch (index)
	{
	case -1:
		LCD_Clear(WHITE);
		POINT_COLOR = BLACK;
		LCD_ShowString(ACTR_DISP_SET_COL(ACRT_DISP_COL_TAB), ACTR_DISP_SET_ROW(-1), ACTR_DISP_STA_LABELWIDTH, ACTR_DISP_STA_LABELHEIGHT, ACTR_DISP_FONTSIZE, LCD_MODE_OVERLAY, "HOMING:");
		LCD_ShowString(ACTR_DISP_SET_COL(ACRT_DISP_COL_TAB), ACTR_DISP_SET_ROW(1), ACTR_DISP_STA_LABELWIDTH, ACTR_DISP_STA_LABELHEIGHT, ACTR_DISP_FONTSIZE, LCD_MODE_OVERLAY, "LM1:");
		LCD_ShowString(ACTR_DISP_SET_COL(ACRT_DISP_COL_TAB), ACTR_DISP_SET_ROW(2), ACTR_DISP_STA_LABELWIDTH, ACTR_DISP_STA_LABELHEIGHT, ACTR_DISP_FONTSIZE, LCD_MODE_OVERLAY, "LM2:");
		LCD_ShowString(ACTR_DISP_SET_COL(ACRT_DISP_COL_TAB), ACTR_DISP_SET_ROW(3), ACTR_DISP_STA_LABELWIDTH, ACTR_DISP_STA_LABELHEIGHT, ACTR_DISP_FONTSIZE, LCD_MODE_OVERLAY, "TM:");
		LCD_ShowString(ACTR_DISP_SET_COL(ACRT_DISP_COL_TAB), ACTR_DISP_SET_ROW(4), ACTR_DISP_STA_LABELWIDTH, ACTR_DISP_STA_LABELHEIGHT, ACTR_DISP_FONTSIZE, LCD_MODE_OVERLAY, "RM2:");
		LCD_ShowString(ACTR_DISP_SET_COL(ACRT_DISP_COL_TAB), ACTR_DISP_SET_ROW(5), ACTR_DISP_STA_LABELWIDTH, ACTR_DISP_STA_LABELHEIGHT, ACTR_DISP_FONTSIZE, LCD_MODE_OVERLAY, "RM1:");
		MoveActrHomingCursor();
		break;
	case 1:
		LCD_ShowString(ACTR_DISP_SET_COL(ACRT_DISP_COL_TAB), ACTR_DISP_SET_ROW(1), ACTR_DISP_STA_LABELWIDTH, ACTR_DISP_STA_LABELHEIGHT, ACTR_DISP_FONTSIZE, LCD_MODE_OVERLAY, "LM1:");
		break;
	case 2:
		LCD_ShowString(ACTR_DISP_SET_COL(ACRT_DISP_COL_TAB), ACTR_DISP_SET_ROW(2), ACTR_DISP_STA_LABELWIDTH, ACTR_DISP_STA_LABELHEIGHT, ACTR_DISP_FONTSIZE, LCD_MODE_OVERLAY, "LM2:");
		break;
	case 3:
		LCD_ShowString(ACTR_DISP_SET_COL(ACRT_DISP_COL_TAB), ACTR_DISP_SET_ROW(3), ACTR_DISP_STA_LABELWIDTH, ACTR_DISP_STA_LABELHEIGHT, ACTR_DISP_FONTSIZE, LCD_MODE_OVERLAY, "TM");
		break;
	case 4:
		LCD_ShowString(ACTR_DISP_SET_COL(ACRT_DISP_COL_TAB), ACTR_DISP_SET_ROW(4), ACTR_DISP_STA_LABELWIDTH, ACTR_DISP_STA_LABELHEIGHT, ACTR_DISP_FONTSIZE, LCD_MODE_OVERLAY, "RM2");
		break;
	case 5:
		LCD_ShowString(ACTR_DISP_SET_COL(ACRT_DISP_COL_TAB), ACTR_DISP_SET_ROW(5), ACTR_DISP_STA_LABELWIDTH, ACTR_DISP_STA_LABELHEIGHT, ACTR_DISP_FONTSIZE, LCD_MODE_OVERLAY, "RM1");
		break;
	}
}

void ShowActrHoming(HomingFlagTypedef homingflag)
{
	char str[14];
	char id_index;

	id_index = ActrHomingCursorIndex - 1;

	if (homingflag == HOMING_FLAG_CORRECT)
	{
		sprintf(str, "ID%3d Correct", devIDList[id_index]);
	}
	else
	{
		sprintf(str, "ID%3d Error", devIDList[id_index]);
	}

	switch (ActrHomingCursorIndex - 1)
	{
	case 0:
		LCD_ShowString(ACTR_DISP_SET_COL(ACRT_DISP_COL_TAB + ACTR_DISP_STA_LABELLEN + ACTR_DISP_DYN_STRINGLEN_S), ACTR_DISP_SET_ROW(1), ACTR_DISP_DYN_STRINGWIDTH_L, ACTR_DISP_DYN_STRINGHEIGHT, ACTR_DISP_FONTSIZE, LCD_MODE_OVERLAY, (u8 *)str);
		break;
	case 1:
		LCD_ShowString(ACTR_DISP_SET_COL(ACRT_DISP_COL_TAB + ACTR_DISP_STA_LABELLEN + ACTR_DISP_DYN_STRINGLEN_S), ACTR_DISP_SET_ROW(2), ACTR_DISP_DYN_STRINGWIDTH_L, ACTR_DISP_DYN_STRINGHEIGHT, ACTR_DISP_FONTSIZE, LCD_MODE_OVERLAY, (u8 *)str);
		break;
	case 2:
		LCD_ShowString(ACTR_DISP_SET_COL(ACRT_DISP_COL_TAB + ACTR_DISP_STA_LABELLEN + ACTR_DISP_DYN_STRINGLEN_S), ACTR_DISP_SET_ROW(3), ACTR_DISP_DYN_STRINGWIDTH_L, ACTR_DISP_DYN_STRINGHEIGHT, ACTR_DISP_FONTSIZE, LCD_MODE_OVERLAY, (u8 *)str);
		break;
	case 3:
		LCD_ShowString(ACTR_DISP_SET_COL(ACRT_DISP_COL_TAB + ACTR_DISP_STA_LABELLEN + ACTR_DISP_DYN_STRINGLEN_S), ACTR_DISP_SET_ROW(4), ACTR_DISP_DYN_STRINGWIDTH_L, ACTR_DISP_DYN_STRINGHEIGHT, ACTR_DISP_FONTSIZE, LCD_MODE_OVERLAY, (u8 *)str);
		break;
	case 4:
		LCD_ShowString(ACTR_DISP_SET_COL(ACRT_DISP_COL_TAB + ACTR_DISP_STA_LABELLEN + ACTR_DISP_DYN_STRINGLEN_S), ACTR_DISP_SET_ROW(5), ACTR_DISP_DYN_STRINGWIDTH_L, ACTR_DISP_DYN_STRINGHEIGHT, ACTR_DISP_FONTSIZE, LCD_MODE_OVERLAY, (u8 *)str);
		break;
	}
}

int ActrAllParaCursorIndex = 0;

void MoveActrAllParaCursor(void)
{
}

void ShowActrAllParaTitle(void)
{
	LCD_Clear(WHITE);
	POINT_COLOR = BLACK;
	LCD_ShowString(ACTR_DISP_SET_COL(ACRT_DISP_COL_TAB), ACTR_DISP_SET_ROW(-1), ACTR_DISP_STA_LABELWIDTH, ACTR_DISP_STA_LABELHEIGHT, ACTR_DISP_FONTSIZE, LCD_MODE_OVERLAY, "ACTR-PARA:");
	LCD_ShowString(ACTR_DISP_SET_COL(ACRT_DISP_COL_TAB), ACTR_DISP_SET_ROW(2), ACTR_DISP_STA_LABELWIDTH, ACTR_DISP_STA_LABELHEIGHT, ACTR_DISP_FONTSIZE, LCD_MODE_OVERLAY, "ACTR-ID:");
	LCD_ShowString(ACTR_DISP_SET_COL(ACRT_DISP_COL_TAB), ACTR_DISP_SET_ROW(3), ACTR_DISP_STA_LABELWIDTH, ACTR_DISP_STA_LABELHEIGHT, ACTR_DISP_FONTSIZE, LCD_MODE_OVERLAY, "ACTR-MODE:");
	LCD_ShowString(ACTR_DISP_SET_COL(ACRT_DISP_COL_TAB), ACTR_DISP_SET_ROW(4), ACTR_DISP_STA_LABELWIDTH, ACTR_DISP_STA_LABELHEIGHT, ACTR_DISP_FONTSIZE, LCD_MODE_OVERLAY, "CURRENT:");
	LCD_ShowString(ACTR_DISP_SET_COL(ACRT_DISP_COL_TAB), ACTR_DISP_SET_ROW(5), ACTR_DISP_STA_LABELWIDTH, ACTR_DISP_STA_LABELHEIGHT, ACTR_DISP_FONTSIZE, LCD_MODE_OVERLAY, "VELOCITY:");
	LCD_ShowString(ACTR_DISP_SET_COL(ACRT_DISP_COL_TAB), ACTR_DISP_SET_ROW(6), ACTR_DISP_STA_LABELWIDTH, ACTR_DISP_STA_LABELHEIGHT, ACTR_DISP_FONTSIZE, LCD_MODE_OVERLAY, "POSITION:");
	LCD_ShowString(ACTR_DISP_SET_COL(ACRT_DISP_COL_TAB), ACTR_DISP_SET_ROW(7), ACTR_DISP_STA_LABELWIDTH, ACTR_DISP_STA_LABELHEIGHT, ACTR_DISP_FONTSIZE, LCD_MODE_OVERLAY, "MAX-SPD:");
	LCD_ShowString(ACTR_DISP_SET_COL(ACRT_DISP_COL_TAB), ACTR_DISP_SET_ROW(8), ACTR_DISP_STA_LABELWIDTH, ACTR_DISP_STA_LABELHEIGHT, ACTR_DISP_FONTSIZE, LCD_MODE_OVERLAY, "MAX-POS:");
	LCD_ShowString(ACTR_DISP_SET_COL(ACRT_DISP_COL_TAB), ACTR_DISP_SET_ROW(9), ACTR_DISP_STA_LABELWIDTH, ACTR_DISP_STA_LABELHEIGHT, ACTR_DISP_FONTSIZE, LCD_MODE_OVERLAY, "MIN-POS:");
	LCD_ShowString(ACTR_DISP_SET_COL(ACRT_DISP_COL_TAB), ACTR_DISP_SET_ROW(10), ACTR_DISP_STA_LABELWIDTH, ACTR_DISP_STA_LABELHEIGHT, ACTR_DISP_FONTSIZE, LCD_MODE_OVERLAY, "ACC-:");
	LCD_ShowString(ACTR_DISP_SET_COL(ACRT_DISP_COL_TAB), ACTR_DISP_SET_ROW(11), ACTR_DISP_STA_LABELWIDTH, ACTR_DISP_STA_LABELHEIGHT, ACTR_DISP_FONTSIZE, LCD_MODE_OVERLAY, "DEC-:");
	LCD_ShowString(ACTR_DISP_SET_COL(ACRT_DISP_COL_TAB), ACTR_DISP_SET_ROW(12), ACTR_DISP_STA_LABELWIDTH, ACTR_DISP_STA_LABELHEIGHT, ACTR_DISP_FONTSIZE, LCD_MODE_OVERLAY, "SPDMAXOUT:");
	LCD_ShowString(ACTR_DISP_SET_COL(ACRT_DISP_COL_TAB), ACTR_DISP_SET_ROW(13), ACTR_DISP_STA_LABELWIDTH, ACTR_DISP_STA_LABELHEIGHT, ACTR_DISP_FONTSIZE, LCD_MODE_OVERLAY, "SPDMINOUT:");
	LCD_ShowString(ACTR_DISP_SET_COL(ACRT_DISP_COL_TAB), ACTR_DISP_SET_ROW(14), ACTR_DISP_STA_LABELWIDTH, ACTR_DISP_STA_LABELHEIGHT, ACTR_DISP_FONTSIZE, LCD_MODE_OVERLAY, "SHUTDOWN:");
}

void ShowActrAllPara(void)
{
	char sActrId[10];
	char sActrCurrent[10];
	char sActrVelocity[10];
	char sActrPosition[10];
	char sActrTshapPosMaxSpeed[10];
	char sActrPosUpperLimit[10];
	char sActrPosLowerLimit[10];
	char sActrTshapPosAccelerate[10];
	char sActrTshapPosDecelerate[10];
	char sActrSpeedOutputUpperLimit[10];
	char sActrSpeedOutputLowerLimit[10];

	static ActrParaTypedef *pActrParaDev = NULL;

	pActrParaDev = FindActrDevByID(devIDList[ActrAllParaCursorIndex]);

	sprintf(sActrId, "%3d", pActrParaDev->actrID);
	sprintf(sActrCurrent, "%5.2fA", pActrParaDev->actrCurrent * 33.0f);
	sprintf(sActrVelocity, "%6.3fr/min", pActrParaDev->actrSpeed);
	sprintf(sActrPosition, "%6.2fR", pActrParaDev->actrPostion);
	sprintf(sActrTshapPosMaxSpeed, "%6.3fr/min", pActrParaDev->actrTshapPosMaxSpeed);
	sprintf(sActrPosUpperLimit, "%6.2fR", pActrParaDev->actrPosUpperLimit);
	sprintf(sActrPosLowerLimit, "%6.2fR", pActrParaDev->actrPosLowerLimit);
	sprintf(sActrTshapPosAccelerate, "%5.2f", pActrParaDev->actrTshapPosAccelerate);
	sprintf(sActrTshapPosDecelerate, "%5.2f", pActrParaDev->actrTshapPosDecelerate);
	sprintf(sActrSpeedOutputUpperLimit, "%5.3f", pActrParaDev->actrSpeedOutputUpperLimit);
	sprintf(sActrSpeedOutputLowerLimit, "%5.3f", pActrParaDev->actrSpeedOutputLowerLimit);

	POINT_COLOR = BLACK;

	switch (ActrAllParaCursorIndex)
	{
	case 0:
		LCD_ShowString(ACTR_DISP_SET_COL(ACRT_DISP_COL_TAB), ACTR_DISP_SET_ROW(1), ACTR_DISP_STA_LABELWIDTH, ACTR_DISP_STA_LABELHEIGHT, ACTR_DISP_FONTSIZE, LCD_MODE_NOT_OVERLAY, "LM1:");
		break;
	case 1:
		LCD_ShowString(ACTR_DISP_SET_COL(ACRT_DISP_COL_TAB), ACTR_DISP_SET_ROW(1), ACTR_DISP_STA_LABELWIDTH, ACTR_DISP_STA_LABELHEIGHT, ACTR_DISP_FONTSIZE, LCD_MODE_NOT_OVERLAY, "LM2:");
		break;
	case 2:
		LCD_ShowString(ACTR_DISP_SET_COL(ACRT_DISP_COL_TAB), ACTR_DISP_SET_ROW(1), ACTR_DISP_STA_LABELWIDTH, ACTR_DISP_STA_LABELHEIGHT, ACTR_DISP_FONTSIZE, LCD_MODE_NOT_OVERLAY, "TM");
		break;
	case 3:
		LCD_ShowString(ACTR_DISP_SET_COL(ACRT_DISP_COL_TAB), ACTR_DISP_SET_ROW(1), ACTR_DISP_STA_LABELWIDTH, ACTR_DISP_STA_LABELHEIGHT, ACTR_DISP_FONTSIZE, LCD_MODE_NOT_OVERLAY, "RM2");
		break;
	case 4:
		LCD_ShowString(ACTR_DISP_SET_COL(ACRT_DISP_COL_TAB), ACTR_DISP_SET_ROW(1), ACTR_DISP_STA_LABELWIDTH, ACTR_DISP_STA_LABELHEIGHT, ACTR_DISP_FONTSIZE, LCD_MODE_NOT_OVERLAY, "RM1");
		break;
	}

	LCD_ShowString(ACTR_DISP_SET_COL(ACRT_DISP_COL_TAB + ACTR_DISP_STA_LABELLEN), ACTR_DISP_SET_ROW(2), ACTR_DISP_DYN_STRINGWIDTH_L, ACTR_DISP_DYN_STRINGHEIGHT, ACTR_DISP_FONTSIZE, LCD_MODE_NOT_OVERLAY, (u8 *)sActrId);
	switch (pActrParaDev->actrMode)
	{
	case ACTR_MODE_CUR:
		LCD_ShowString(ACTR_DISP_SET_COL(ACRT_DISP_COL_TAB + ACTR_DISP_STA_LABELLEN), ACTR_DISP_SET_ROW(3), ACTR_DISP_DYN_STRINGWIDTH_L, ACTR_DISP_DYN_STRINGHEIGHT, ACTR_DISP_FONTSIZE, LCD_MODE_NOT_OVERLAY, "Current-Mode");
		break;
	case ACTR_MODE_SPD:
		LCD_ShowString(ACTR_DISP_SET_COL(ACRT_DISP_COL_TAB + ACTR_DISP_STA_LABELLEN), ACTR_DISP_SET_ROW(3), ACTR_DISP_DYN_STRINGWIDTH_L, ACTR_DISP_DYN_STRINGHEIGHT, ACTR_DISP_FONTSIZE, LCD_MODE_NOT_OVERLAY, "Speed-Mode");
		break;
	case ACTR_MODE_POS:
		LCD_ShowString(ACTR_DISP_SET_COL(ACRT_DISP_COL_TAB + ACTR_DISP_STA_LABELLEN), ACTR_DISP_SET_ROW(3), ACTR_DISP_DYN_STRINGWIDTH_L, ACTR_DISP_DYN_STRINGHEIGHT, ACTR_DISP_FONTSIZE, LCD_MODE_NOT_OVERLAY, "Position-Mode");
		break;
	case ACTR_MODE_TECH:
		LCD_ShowString(ACTR_DISP_SET_COL(ACRT_DISP_COL_TAB + ACTR_DISP_STA_LABELLEN), ACTR_DISP_SET_ROW(3), ACTR_DISP_DYN_STRINGWIDTH_L, ACTR_DISP_DYN_STRINGHEIGHT, ACTR_DISP_FONTSIZE, LCD_MODE_NOT_OVERLAY, "Teach-Mode");
		break;
	case ACTR_MODE_PLAY:
		LCD_ShowString(ACTR_DISP_SET_COL(ACRT_DISP_COL_TAB + ACTR_DISP_STA_LABELLEN), ACTR_DISP_SET_ROW(3), ACTR_DISP_DYN_STRINGWIDTH_L, ACTR_DISP_DYN_STRINGHEIGHT, ACTR_DISP_FONTSIZE, LCD_MODE_NOT_OVERLAY, "Play-Mode");
		break;
	case ACTR_MODE_TSHAP_POS:
		LCD_ShowString(ACTR_DISP_SET_COL(ACRT_DISP_COL_TAB + ACTR_DISP_STA_LABELLEN), ACTR_DISP_SET_ROW(3), ACTR_DISP_DYN_STRINGWIDTH_L, ACTR_DISP_DYN_STRINGHEIGHT, ACTR_DISP_FONTSIZE, LCD_MODE_NOT_OVERLAY, "Profile-Pos-Mode");
		break;
	case ACTR_MODE_TSHAP_SPD:
		LCD_ShowString(ACTR_DISP_SET_COL(ACRT_DISP_COL_TAB + ACTR_DISP_STA_LABELLEN), ACTR_DISP_SET_ROW(3), ACTR_DISP_DYN_STRINGWIDTH_L, ACTR_DISP_DYN_STRINGHEIGHT, ACTR_DISP_FONTSIZE, LCD_MODE_NOT_OVERLAY, "Profile-Spd-Mode");
		break;
	case ACTR_MODE_HOMING:
		LCD_ShowString(ACTR_DISP_SET_COL(ACRT_DISP_COL_TAB + ACTR_DISP_STA_LABELLEN), ACTR_DISP_SET_ROW(3), ACTR_DISP_DYN_STRINGWIDTH_L, ACTR_DISP_DYN_STRINGHEIGHT, ACTR_DISP_FONTSIZE, LCD_MODE_NOT_OVERLAY, "Homing-Mode");
		break;
	}

	LCD_ShowString(ACTR_DISP_SET_COL(ACRT_DISP_COL_TAB + ACTR_DISP_STA_LABELLEN), ACTR_DISP_SET_ROW(4), ACTR_DISP_DYN_STRINGWIDTH_L, ACTR_DISP_DYN_STRINGHEIGHT, ACTR_DISP_FONTSIZE, LCD_MODE_NOT_OVERLAY, (u8 *)sActrCurrent);
	LCD_ShowString(ACTR_DISP_SET_COL(ACRT_DISP_COL_TAB + ACTR_DISP_STA_LABELLEN), ACTR_DISP_SET_ROW(5), ACTR_DISP_DYN_STRINGWIDTH_L, ACTR_DISP_DYN_STRINGHEIGHT, ACTR_DISP_FONTSIZE, LCD_MODE_NOT_OVERLAY, (u8 *)sActrVelocity);
	LCD_ShowString(ACTR_DISP_SET_COL(ACRT_DISP_COL_TAB + ACTR_DISP_STA_LABELLEN), ACTR_DISP_SET_ROW(6), ACTR_DISP_DYN_STRINGWIDTH_L, ACTR_DISP_DYN_STRINGHEIGHT, ACTR_DISP_FONTSIZE, LCD_MODE_NOT_OVERLAY, (u8 *)sActrPosition);
	LCD_ShowString(ACTR_DISP_SET_COL(ACRT_DISP_COL_TAB + ACTR_DISP_STA_LABELLEN), ACTR_DISP_SET_ROW(7), ACTR_DISP_DYN_STRINGWIDTH_L, ACTR_DISP_DYN_STRINGHEIGHT, ACTR_DISP_FONTSIZE, LCD_MODE_NOT_OVERLAY, (u8 *)sActrTshapPosMaxSpeed);
	LCD_ShowString(ACTR_DISP_SET_COL(ACRT_DISP_COL_TAB + ACTR_DISP_STA_LABELLEN), ACTR_DISP_SET_ROW(8), ACTR_DISP_DYN_STRINGWIDTH_L, ACTR_DISP_DYN_STRINGHEIGHT, ACTR_DISP_FONTSIZE, LCD_MODE_NOT_OVERLAY, (u8 *)sActrPosUpperLimit);
	LCD_ShowString(ACTR_DISP_SET_COL(ACRT_DISP_COL_TAB + ACTR_DISP_STA_LABELLEN), ACTR_DISP_SET_ROW(9), ACTR_DISP_DYN_STRINGWIDTH_L, ACTR_DISP_DYN_STRINGHEIGHT, ACTR_DISP_FONTSIZE, LCD_MODE_NOT_OVERLAY, (u8 *)sActrPosLowerLimit);
	LCD_ShowString(ACTR_DISP_SET_COL(ACRT_DISP_COL_TAB + ACTR_DISP_STA_LABELLEN), ACTR_DISP_SET_ROW(10), ACTR_DISP_DYN_STRINGWIDTH_L, ACTR_DISP_DYN_STRINGHEIGHT, ACTR_DISP_FONTSIZE, LCD_MODE_NOT_OVERLAY, (u8 *)sActrTshapPosAccelerate);
	LCD_ShowString(ACTR_DISP_SET_COL(ACRT_DISP_COL_TAB + ACTR_DISP_STA_LABELLEN), ACTR_DISP_SET_ROW(11), ACTR_DISP_DYN_STRINGWIDTH_L, ACTR_DISP_DYN_STRINGHEIGHT, ACTR_DISP_FONTSIZE, LCD_MODE_NOT_OVERLAY, (u8 *)sActrTshapPosDecelerate);
	LCD_ShowString(ACTR_DISP_SET_COL(ACRT_DISP_COL_TAB + ACTR_DISP_STA_LABELLEN), ACTR_DISP_SET_ROW(12), ACTR_DISP_DYN_STRINGWIDTH_L, ACTR_DISP_DYN_STRINGHEIGHT, ACTR_DISP_FONTSIZE, LCD_MODE_NOT_OVERLAY, (u8 *)sActrSpeedOutputUpperLimit);
	LCD_ShowString(ACTR_DISP_SET_COL(ACRT_DISP_COL_TAB + ACTR_DISP_STA_LABELLEN), ACTR_DISP_SET_ROW(13), ACTR_DISP_DYN_STRINGWIDTH_L, ACTR_DISP_DYN_STRINGHEIGHT, ACTR_DISP_FONTSIZE, LCD_MODE_NOT_OVERLAY, (u8 *)sActrSpeedOutputLowerLimit);

	if (pActrParaDev->actrShutdownState == SHUTDOWN_FALSE)
	{
		POINT_COLOR = RED;
		LCD_ShowString(ACTR_DISP_SET_COL(ACRT_DISP_COL_TAB + ACTR_DISP_STA_LABELLEN), ACTR_DISP_SET_ROW(14), ACTR_DISP_DYN_STRINGWIDTH_L, ACTR_DISP_DYN_STRINGHEIGHT, ACTR_DISP_FONTSIZE, LCD_MODE_NOT_OVERLAY, "Shutdown Badly");
	}
	else
	{
		LCD_ShowString(ACTR_DISP_SET_COL(ACRT_DISP_COL_TAB + ACTR_DISP_STA_LABELLEN), ACTR_DISP_SET_ROW(14), ACTR_DISP_DYN_STRINGWIDTH_L, ACTR_DISP_DYN_STRINGHEIGHT, ACTR_DISP_FONTSIZE, LCD_MODE_NOT_OVERLAY, "Shutdown Well");
	}
}

extern int8_t RemoteData[7];

int DevParaCursorIndex = 0;

void MoveDevParaCursor(void)
{
}

void ShowDevParaTitle(void)
{
	LCD_Clear(WHITE);
	POINT_COLOR = BLACK;

	LCD_ShowString(ACTR_DISP_SET_COL(ACRT_DISP_COL_TAB), ACTR_DISP_SET_ROW(-1), ACTR_DISP_STA_LABELWIDTH, ACTR_DISP_STA_LABELHEIGHT, ACTR_DISP_FONTSIZE, LCD_MODE_OVERLAY, "DEV-PARA:");
	LCD_ShowString(ACTR_DISP_SET_COL(ACRT_DISP_COL_TAB), ACTR_DISP_SET_ROW(1), ACTR_DISP_STA_LABELWIDTH, ACTR_DISP_STA_LABELHEIGHT, ACTR_DISP_FONTSIZE, LCD_MODE_OVERLAY, "Remote_LX:");
	LCD_ShowString(ACTR_DISP_SET_COL(ACRT_DISP_COL_TAB), ACTR_DISP_SET_ROW(2), ACTR_DISP_STA_LABELWIDTH, ACTR_DISP_STA_LABELHEIGHT, ACTR_DISP_FONTSIZE, LCD_MODE_OVERLAY, "Remote_LY:");
	LCD_ShowString(ACTR_DISP_SET_COL(ACRT_DISP_COL_TAB), ACTR_DISP_SET_ROW(3), ACTR_DISP_STA_LABELWIDTH, ACTR_DISP_STA_LABELHEIGHT, ACTR_DISP_FONTSIZE, LCD_MODE_OVERLAY, "Remote_RX:");
	LCD_ShowString(ACTR_DISP_SET_COL(ACRT_DISP_COL_TAB), ACTR_DISP_SET_ROW(4), ACTR_DISP_STA_LABELWIDTH, ACTR_DISP_STA_LABELHEIGHT, ACTR_DISP_FONTSIZE, LCD_MODE_OVERLAY, "Remote_RY:");
	LCD_ShowString(ACTR_DISP_SET_COL(ACRT_DISP_COL_TAB), ACTR_DISP_SET_ROW(5), ACTR_DISP_STA_LABELWIDTH, ACTR_DISP_STA_LABELHEIGHT, ACTR_DISP_FONTSIZE, LCD_MODE_OVERLAY, "Remote_LS:");
	LCD_ShowString(ACTR_DISP_SET_COL(ACRT_DISP_COL_TAB), ACTR_DISP_SET_ROW(6), ACTR_DISP_STA_LABELWIDTH, ACTR_DISP_STA_LABELHEIGHT, ACTR_DISP_FONTSIZE, LCD_MODE_OVERLAY, "Remote_RS:");
	LCD_ShowString(ACTR_DISP_SET_COL(ACRT_DISP_COL_TAB), ACTR_DISP_SET_ROW(7), ACTR_DISP_STA_LABELWIDTH, ACTR_DISP_STA_LABELHEIGHT, ACTR_DISP_FONTSIZE, LCD_MODE_OVERLAY, "Remote_VA:");
}

void ShowDevPara(void)
{
	static char sRemote_LX[2][5];
	static char sRemote_LY[2][5];
	static char sRemote_RX[2][5];
	static char sRemote_RY[2][5];
	static char sRemote_LS[2][5];
	static char sRemote_RS[2][5];
	static char sRemote_VA[2][5];

	sprintf(sRemote_LX[0], "%4d", RemoteData[0]);
	sprintf(sRemote_LY[0], "%4d", RemoteData[1]);
	sprintf(sRemote_RX[0], "%4d", RemoteData[2]);
	sprintf(sRemote_RY[0], "%4d", RemoteData[3]);
	sprintf(sRemote_LS[0], "%4d", RemoteData[4]);
	sprintf(sRemote_RS[0], "%4d", RemoteData[5]);
	sprintf(sRemote_VA[0], "%4d", (unsigned char)RemoteData[6]);

	POINT_COLOR = BLACK;

	LCD_FastShowString(ACTR_DISP_SET_COL(ACRT_DISP_COL_TAB + ACTR_DISP_STA_LABELLEN), ACTR_DISP_SET_ROW(1), ACTR_DISP_DYN_STRINGWIDTH_L, ACTR_DISP_DYN_STRINGHEIGHT, ACTR_DISP_FONTSIZE, LCD_MODE_NOT_OVERLAY, (u8 *)sRemote_LX[1], (u8 *)sRemote_LX[0]);
	LCD_FastShowString(ACTR_DISP_SET_COL(ACRT_DISP_COL_TAB + ACTR_DISP_STA_LABELLEN), ACTR_DISP_SET_ROW(2), ACTR_DISP_DYN_STRINGWIDTH_L, ACTR_DISP_DYN_STRINGHEIGHT, ACTR_DISP_FONTSIZE, LCD_MODE_NOT_OVERLAY, (u8 *)sRemote_LY[1], (u8 *)sRemote_LY[0]);
	LCD_FastShowString(ACTR_DISP_SET_COL(ACRT_DISP_COL_TAB + ACTR_DISP_STA_LABELLEN), ACTR_DISP_SET_ROW(3), ACTR_DISP_DYN_STRINGWIDTH_L, ACTR_DISP_DYN_STRINGHEIGHT, ACTR_DISP_FONTSIZE, LCD_MODE_NOT_OVERLAY, (u8 *)sRemote_RX[1], (u8 *)sRemote_RX[0]);
	LCD_FastShowString(ACTR_DISP_SET_COL(ACRT_DISP_COL_TAB + ACTR_DISP_STA_LABELLEN), ACTR_DISP_SET_ROW(4), ACTR_DISP_DYN_STRINGWIDTH_L, ACTR_DISP_DYN_STRINGHEIGHT, ACTR_DISP_FONTSIZE, LCD_MODE_NOT_OVERLAY, (u8 *)sRemote_RY[1], (u8 *)sRemote_RY[0]);
	LCD_FastShowString(ACTR_DISP_SET_COL(ACRT_DISP_COL_TAB + ACTR_DISP_STA_LABELLEN), ACTR_DISP_SET_ROW(5), ACTR_DISP_DYN_STRINGWIDTH_L, ACTR_DISP_DYN_STRINGHEIGHT, ACTR_DISP_FONTSIZE, LCD_MODE_NOT_OVERLAY, (u8 *)sRemote_LS[1], (u8 *)sRemote_LS[0]);
	LCD_FastShowString(ACTR_DISP_SET_COL(ACRT_DISP_COL_TAB + ACTR_DISP_STA_LABELLEN), ACTR_DISP_SET_ROW(6), ACTR_DISP_DYN_STRINGWIDTH_L, ACTR_DISP_DYN_STRINGHEIGHT, ACTR_DISP_FONTSIZE, LCD_MODE_NOT_OVERLAY, (u8 *)sRemote_RS[1], (u8 *)sRemote_RS[0]);
	LCD_FastShowString(ACTR_DISP_SET_COL(ACRT_DISP_COL_TAB + ACTR_DISP_STA_LABELLEN), ACTR_DISP_SET_ROW(7), ACTR_DISP_DYN_STRINGWIDTH_L, ACTR_DISP_DYN_STRINGHEIGHT, ACTR_DISP_FONTSIZE, LCD_MODE_NOT_OVERLAY, (u8 *)sRemote_VA[1], (u8 *)sRemote_VA[0]);
}
